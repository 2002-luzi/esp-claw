## application/basic_demo/main/Kconfig.projbuild
```kconfig
menu "Basic Demo Config"

config BASIC_DEMO_WIFI_SSID
    string "Default Wi-Fi SSID"
    default ""
    help
        Default Wi-Fi SSID used to populate basic demo settings.

config BASIC_DEMO_WIFI_PASSWORD
    string "Default Wi-Fi password"
    default ""
    help
        Default Wi-Fi password used to populate basic demo settings.

config BASIC_DEMO_LLM_API_KEY
    string "Default LLM API key"
    default ""
    help
        Default API key used to populate the basic demo LLM settings.

config BASIC_DEMO_LLM_BACKEND_TYPE
    string "Default LLM backend type"
    default "openai_compatible"
    help
        Default backend type for claw_core, for example openai_compatible or custom.

config BASIC_DEMO_LLM_PROFILE
    string "Default LLM profile"
    default "qwen_compatible"
    help
        Default runtime profile for claw_core, for example openai, qwen_compatible, or custom_openai_compatible.

config BASIC_DEMO_LLM_MODEL
    string "Default LLM model"
    default "qwen3-max-2026-01-23"
    help
        Default model name for claw_core requests.

config BASIC_DEMO_LLM_BASE_URL
    string "Default LLM base URL"
    default ""
    help
        Optional override for the selected LLM profile base URL.

config BASIC_DEMO_LLM_AUTH_TYPE
    string "Default LLM auth type"
    default "bearer"
    help
        Auth mode for the LLM backend, for example bearer, api-key, or none.

config BASIC_DEMO_LLM_TIMEOUT_MS
    string "Default LLM timeout ms"
    default "120000"
    help
        Timeout in milliseconds for outbound LLM HTTP requests.

config BASIC_DEMO_QQ_APP_ID
    string "Default QQ app ID"
    default ""
    help
        Default QQ app ID used by the IM cap.

config BASIC_DEMO_QQ_APP_SECRET
    string "Default QQ app secret"
    default ""
    help
        Default QQ app secret used by the IM cap.

config BASIC_DEMO_TG_BOT_TOKEN
    string "Default Telegram bot token"
    default ""
    help
        Default Telegram bot token used by the IM cap.

config BASIC_DEMO_WECHAT_TOKEN
    string "Default WeChat token"
    default ""
    help
        Default WeChat bot token used by the IM cap.

config BASIC_DEMO_WECHAT_BASE_URL
    string "Default WeChat base URL"
    default "https://ilinkai.weixin.qq.com"
    help
        Default WeChat API base URL used by the IM cap.

config BASIC_DEMO_WECHAT_CDN_BASE_URL
    string "Default WeChat CDN base URL"
    default "https://novac2c.cdn.weixin.qq.com/c2c"
    help
        Default WeChat CDN base URL used for media upload and download.

config BASIC_DEMO_WECHAT_ACCOUNT_ID
    string "Default WeChat account ID"
    default "default"
    help
        Default logical account ID for local WeChat channel state.

config BASIC_DEMO_SEARCH_BRAVE_KEY
    string "Default Brave Search API key"
    default ""
    help
        Default Brave Search API key for the web search cap.

config BASIC_DEMO_SEARCH_TAVILY_KEY
    string "Default Tavily API key"
    default ""
    help
        Default Tavily API key for the web search cap.

config BASIC_DEMO_TIME_TIMEZONE
    string "Default time cap timezone"
    default "UTC0"
    help
        POSIX-style timezone string used by the time cap.

config BASIC_DEMO_TTS_XFYUN_APP_ID
    string "Default XFYun TTS app ID"
    default ""
    help
        Default XFYun TTS app ID used to populate the local TTS runtime settings.

config BASIC_DEMO_TTS_XFYUN_API_KEY
    string "Default XFYun TTS API key"
    default ""
    help
        Default XFYun TTS API key used to populate the local TTS runtime settings.

config BASIC_DEMO_TTS_XFYUN_API_SECRET
    string "Default XFYun TTS API secret"
    default ""
    help
        Default XFYun TTS API secret used to populate the local TTS runtime settings.

config BASIC_DEMO_TTS_XFYUN_VOICE_NAME
    string "Default XFYun TTS voice name"
    default "x4_yezi"
    help
        Default XFYun voice name such as x4_yezi.

config BASIC_DEMO_TTS_XFYUN_AUDIO_ENCODING
    string "Default XFYun TTS audio encoding"
    default "raw"
    help
        Default XFYun audio encoding expected by the local playback path.

config BASIC_DEMO_TTS_XFYUN_AUDIO_FORMAT
    string "Default XFYun TTS audio format"
    default "audio/L16;rate=16000"
    help
        Default XFYun audio format string, for example audio/L16;rate=16000.

config BASIC_DEMO_TTS_XFYUN_TEXT_ENCODING
    string "Default XFYun TTS text encoding"
    default "utf8"
    help
        Default text encoding sent to the XFYun TTS provider.

config BASIC_DEMO_TTS_XFYUN_WEBSOCKET_URI
    string "Default XFYun TTS websocket URI"
    default "wss://tts-api.xfyun.cn/v2/tts"
    help
        Default websocket endpoint for the XFYun TTS provider.

config BASIC_DEMO_TTS_XFYUN_AUTH_HOST
    string "Default XFYun TTS auth host"
    default "tts-api.xfyun.cn"
    help
        Host name used when generating the XFYun websocket authorization header.

config BASIC_DEMO_TTS_TIMEOUT_MS
    string "Default TTS provider timeout ms"
    default "30000"
    help
        Timeout in milliseconds for one outbound TTS request.

config BASIC_DEMO_TTS_ENABLE_SPEAKER_OUTPUT
    bool "Enable board speaker output for TTS"
    default n
    help
        Enable the board-specific speaker adapter. Leave disabled for provider-only bring-up.

endmenu
```

## components/lua_modules/lua_module_tts/Kconfig
```kconfig
menu "Lua TTS module"

config LUA_TTS_MEMORY_PROFILING
    bool "Enable Lua TTS memory profiling logs"
    default n
    help
        Enable detailed heap and current-task stack high-water logs around Lua
        TTS playback, HTTP/TLS setup, audio conversion, and cleanup checkpoints.
        Keep this disabled for normal firmware builds because it adds verbose
        diagnostic logs.

config LUA_TTS_CHUNK_MS
    int "Lua TTS source PCM chunk duration in milliseconds"
    range 10 120
    default 30
    help
        Configure how much provider PCM the Lua TTS sink accumulates before
        converting and writing to the codec. Smaller values reduce each
        synchronous codec write window and can make streamed playback more
        responsive to network bursts, at the cost of more frequent conversion
        and write calls.

config LUA_TTS_SOURCE_BUFFER_MS
    int "Lua TTS source PCM ring buffer duration in milliseconds"
    range 0 500
    default 120
    help
        Configure the source PCM stream buffer used to decouple network TTS
        delivery from codec writes. The buffer stores provider PCM before ASRC,
        so MiMo 24 kHz mono 16-bit PCM costs about 48 bytes per millisecond.
        Set to 0 to disable buffered playback and use the synchronous path.

config LUA_TTS_PREBUFFER_MS
    int "Lua TTS source PCM prebuffer duration in milliseconds"
    range 0 250
    default 60
    help
        Configure how much source PCM must be queued before the playback task
        starts writing to the codec. This absorbs short network/SSE delivery
        gaps without buffering the larger converted output PCM.

endmenu
```
